## build/hello_oemga/Kconfig/soc/Kconfig.sysbuild
```kconfig
# Load Sysbuild SoC Kconfig descriptions.
osource "/workdir/zephyr/soc/xlnx/zynqmp/Kconfig.sysbuild"
osource "/workdir/zephyr/soc/xlnx/zynq7000/Kconfig.sysbuild"
osource "/workdir/zephyr/soc/xlnx/versalnet/Kconfig.sysbuild"
osource "/workdir/zephyr/soc/xlnx/versal2/Kconfig.sysbuild"
osource "/workdir/zephyr/soc/xen/Kconfig.sysbuild"
osource "/workdir/zephyr/soc/wch/ch32v/Kconfig.sysbuild"
osource "/workdir/zephyr/soc/ti/simplelink/Kconfig.sysbuild"
osource "/workdir/zephyr/soc/ti/mspm0/Kconfig.sysbuild"
osource "/workdir/zephyr/soc/ti/lm3s6965/Kconfig.sysbuild"
osource "/workdir/zephyr/soc/ti/k3/Kconfig.sysbuild"
osource "/workdir/zephyr/soc/telink/tlsr/Kconfig.sysbuild"
osource "/workdir/zephyr/soc/starfive/jh71xx/Kconfig.sysbuild"
osource "/workdir/zephyr/soc/st/stm32/Kconfig.sysbuild"
osource "/workdir/zephyr/soc/snps/qemu_arc/Kconfig.sysbuild"
osource "/workdir/zephyr/soc/snps/nsim/arc_v/Kconfig.sysbuild"
osource "/workdir/zephyr/soc/snps/nsim/arc_classic/Kconfig.sysbuild"
osource "/workdir/zephyr/soc/snps/hsdk4xd/Kconfig.sysbuild"
osource "/workdir/zephyr/soc/snps/hsdk/Kconfig.sysbuild"
osource "/workdir/zephyr/soc/snps/emsk/Kconfig.sysbuild"
osource "/workdir/zephyr/soc/snps/emsdp/Kconfig.sysbuild"
osource "/workdir/zephyr/soc/snps/arc_iot/Kconfig.sysbuild"
osource "/workdir/zephyr/soc/silabs/Kconfig.sysbuild"
osource "/workdir/zephyr/soc/sifive/sifive_freedom/Kconfig.sysbuild"
osource "/workdir/zephyr/soc/sensry/Kconfig.sysbuild"
osource "/workdir/zephyr/soc/rockchip/Kconfig.sysbuild"
osource "/workdir/zephyr/soc/renode/riscv_virtual/Kconfig.sysbuild"
osource "/workdir/zephyr/soc/renode/cortex_r8_virtual/Kconfig.sysbuild"
osource "/workdir/zephyr/soc/renesas/smartbond/Kconfig.sysbuild"
osource "/workdir/zephyr/soc/renesas/rz/Kconfig.sysbuild"
osource "/workdir/zephyr/soc/renesas/rx/Kconfig.sysbuild"
osource "/workdir/zephyr/soc/renesas/rcar/Kconfig.sysbuild"
osource "/workdir/zephyr/soc/renesas/ra/Kconfig.sysbuild"
osource "/workdir/zephyr/soc/realtek/ec/Kconfig.sysbuild"
osource "/workdir/zephyr/soc/raspberrypi/rpi_pico/Kconfig.sysbuild"
osource "/workdir/zephyr/soc/quicklogic/eos_s3/Kconfig.sysbuild"
osource "/workdir/zephyr/soc/qemu/virt_riscv/Kconfig.sysbuild"
osource "/workdir/zephyr/soc/qemu/malta/Kconfig.sysbuild"
osource "/workdir/zephyr/soc/openisa/rv32m1/Kconfig.sysbuild"
osource "/workdir/zephyr/soc/openhwgroup/cva6/Kconfig.sysbuild"
osource "/workdir/zephyr/soc/oct/osd32mp15x/Kconfig.sysbuild"
osource "/workdir/zephyr/soc/nxp/s32/Kconfig.sysbuild"
osource "/workdir/zephyr/soc/nxp/rw/Kconfig.sysbuild"
osource "/workdir/zephyr/soc/nxp/mcx/Kconfig.sysbuild"
osource "/workdir/zephyr/soc/nxp/lpc/Kconfig.sysbuild"
osource "/workdir/zephyr/soc/nxp/layerscape/Kconfig.sysbuild"
osource "/workdir/zephyr/soc/nxp/kinetis/Kconfig.sysbuild"
osource "/workdir/zephyr/soc/nxp/imxrt/Kconfig.sysbuild"
osource "/workdir/zephyr/soc/nxp/imx/Kconfig.sysbuild"
osource "/workdir/zephyr/soc/nuvoton/numicro/Kconfig.sysbuild"
osource "/workdir/zephyr/soc/nuvoton/numaker/Kconfig.sysbuild"
osource "/workdir/zephyr/soc/nuvoton/npcx/Kconfig.sysbuild"
osource "/workdir/zephyr/soc/nuvoton/npcm/Kconfig.sysbuild"
osource "/workdir/zephyr/soc/nordic/Kconfig.sysbuild"
osource "/workdir/zephyr/soc/neorv32/Kconfig.sysbuild"
osource "/workdir/zephyr/soc/native/inf_clock/Kconfig.sysbuild"
osource "/workdir/zephyr/soc/microchip/sam/Kconfig.sysbuild"
osource "/workdir/zephyr/soc/microchip/miv/Kconfig.sysbuild"
osource "/workdir/zephyr/soc/microchip/mec/Kconfig.sysbuild"
osource "/workdir/zephyr/soc/mediatek/mt8xxx/Kconfig.sysbuild"
osource "/workdir/zephyr/soc/lowrisc/opentitan/Kconfig.sysbuild"
osource "/workdir/zephyr/soc/litex/litex_vexriscv/Kconfig.sysbuild"
osource "/workdir/zephyr/soc/ite/ec/Kconfig.sysbuild"
osource "/workdir/zephyr/soc/intel/raptor_lake/Kconfig.sysbuild"
osource "/workdir/zephyr/soc/intel/lakemont/Kconfig.sysbuild"
osource "/workdir/zephyr/soc/intel/intel_socfpga_std/Kconfig.sysbuild"
osource "/workdir/zephyr/soc/intel/intel_socfpga/Kconfig.sysbuild"
osource "/workdir/zephyr/soc/intel/intel_niosv/Kconfig.sysbuild"
osource "/workdir/zephyr/soc/intel/intel_ish/Kconfig.sysbuild"
osource "/workdir/zephyr/soc/intel/intel_adsp/Kconfig.sysbuild"
osource "/workdir/zephyr/soc/intel/elkhart_lake/Kconfig.sysbuild"
osource "/workdir/zephyr/soc/intel/atom/Kconfig.sysbuild"
osource "/workdir/zephyr/soc/intel/apollo_lake/Kconfig.sysbuild"
osource "/workdir/zephyr/soc/intel/alder_lake/Kconfig.sysbuild"
osource "/workdir/zephyr/soc/infineon/cat3/Kconfig.sysbuild"
osource "/workdir/zephyr/soc/infineon/cat1c/Kconfig.sysbuild"
osource "/workdir/zephyr/soc/infineon/cat1b/Kconfig.sysbuild"
osource "/workdir/zephyr/soc/infineon/cat1a/Kconfig.sysbuild"
osource "/workdir/zephyr/soc/gd/gd32/Kconfig.sysbuild"
osource "/workdir/zephyr/soc/gaisler/leon3/Kconfig.sysbuild"
osource "/workdir/zephyr/soc/gaisler/gr716a/Kconfig.sysbuild"
osource "/workdir/zephyr/soc/espressif/Kconfig.sysbuild"
osource "/workdir/zephyr/soc/ene/kb1200/Kconfig.sysbuild"
osource "/workdir/zephyr/soc/efinix/sapphire/Kconfig.sysbuild"
osource "/workdir/zephyr/soc/cdns/xtensa_sample_controller/Kconfig.sysbuild"
osource "/workdir/zephyr/soc/cdns/sample_controller32/Kconfig.sysbuild"
osource "/workdir/zephyr/soc/cdns/dc233c/Kconfig.sysbuild"
osource "/workdir/zephyr/soc/brcm/bcmvk/Kconfig.sysbuild"
osource "/workdir/zephyr/soc/brcm/bcm2712/Kconfig.sysbuild"
osource "/workdir/zephyr/soc/brcm/bcm2711/Kconfig.sysbuild"
osource "/workdir/zephyr/soc/bflb/Kconfig.sysbuild"
osource "/workdir/zephyr/soc/atmel/sam0/Kconfig.sysbuild"
osource "/workdir/zephyr/soc/atmel/sam/Kconfig.sysbuild"
osource "/workdir/zephyr/soc/aspeed/Kconfig.sysbuild"
osource "/workdir/zephyr/soc/arm/Kconfig.sysbuild"
osource "/workdir/zephyr/soc/arm/beetle/Kconfig.sysbuild"
osource "/workdir/zephyr/soc/antmicro/myra/Kconfig.sysbuild"
osource "/workdir/zephyr/soc/andestech/Kconfig.sysbuild"
osource "/workdir/zephyr/soc/amd/acp_6_0/Kconfig.sysbuild"
osource "/workdir/zephyr/soc/ambiq/Kconfig.sysbuild"
osource "/workdir/zephyr/soc/aesc/Kconfig.sysbuild"
osource "/workdir/zephyr/soc/adi/max32/Kconfig.sysbuild"
osource "/workdir/nrf/soc/sercomm/nrf91/Kconfig.sysbuild"
osource "/workdir/nrf/soc/nordic/Kconfig.sysbuild"
```

## west.yml
```yaml
manifest:
  remotes:
    - name: ncs
      url-base: https://github.com/nrfconnect
    - name: zephyr
      url-base: https://github.com/zephyrproject-rtos

  projects:
    - name: sdk-nrf
      remote: ncs
      revision: v3.1.1
      path: nrf
      import: true
      
  self:
    path: oemga-core
```
