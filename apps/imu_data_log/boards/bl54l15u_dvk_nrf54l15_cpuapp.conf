## build/hello_oemga/Kconfig/soc/Kconfig.defconfig
```kconfig
# Load Zephyr SoC defconfig descriptions.
osource "/workdir/zephyr/soc/xlnx/zynqmp/Kconfig.defconfig"
osource "/workdir/zephyr/soc/xlnx/zynq7000/Kconfig.defconfig"
osource "/workdir/zephyr/soc/xlnx/versalnet/Kconfig.defconfig"
osource "/workdir/zephyr/soc/xlnx/versal2/Kconfig.defconfig"
osource "/workdir/zephyr/soc/xen/Kconfig.defconfig"
osource "/workdir/zephyr/soc/wch/ch32v/Kconfig.defconfig"
osource "/workdir/zephyr/soc/ti/simplelink/Kconfig.defconfig"
osource "/workdir/zephyr/soc/ti/mspm0/Kconfig.defconfig"
osource "/workdir/zephyr/soc/ti/lm3s6965/Kconfig.defconfig"
osource "/workdir/zephyr/soc/ti/k3/Kconfig.defconfig"
osource "/workdir/zephyr/soc/telink/tlsr/Kconfig.defconfig"
osource "/workdir/zephyr/soc/starfive/jh71xx/Kconfig.defconfig"
osource "/workdir/zephyr/soc/st/stm32/Kconfig.defconfig"
osource "/workdir/zephyr/soc/snps/qemu_arc/Kconfig.defconfig"
osource "/workdir/zephyr/soc/snps/nsim/arc_v/Kconfig.defconfig"
osource "/workdir/zephyr/soc/snps/nsim/arc_classic/Kconfig.defconfig"
osource "/workdir/zephyr/soc/snps/hsdk4xd/Kconfig.defconfig"
osource "/workdir/zephyr/soc/snps/hsdk/Kconfig.defconfig"
osource "/workdir/zephyr/soc/snps/emsk/Kconfig.defconfig"
osource "/workdir/zephyr/soc/snps/emsdp/Kconfig.defconfig"
osource "/workdir/zephyr/soc/snps/arc_iot/Kconfig.defconfig"
osource "/workdir/zephyr/soc/silabs/Kconfig.defconfig"
osource "/workdir/zephyr/soc/sifive/sifive_freedom/Kconfig.defconfig"
osource "/workdir/zephyr/soc/sensry/Kconfig.defconfig"
osource "/workdir/zephyr/soc/rockchip/Kconfig.defconfig"
osource "/workdir/zephyr/soc/renode/riscv_virtual/Kconfig.defconfig"
osource "/workdir/zephyr/soc/renode/cortex_r8_virtual/Kconfig.defconfig"
osource "/workdir/zephyr/soc/renesas/smartbond/Kconfig.defconfig"
osource "/workdir/zephyr/soc/renesas/rz/Kconfig.defconfig"
osource "/workdir/zephyr/soc/renesas/rx/Kconfig.defconfig"
osource "/workdir/zephyr/soc/renesas/rcar/Kconfig.defconfig"
osource "/workdir/zephyr/soc/renesas/ra/Kconfig.defconfig"
osource "/workdir/zephyr/soc/realtek/ec/Kconfig.defconfig"
osource "/workdir/zephyr/soc/raspberrypi/rpi_pico/Kconfig.defconfig"
osource "/workdir/zephyr/soc/quicklogic/eos_s3/Kconfig.defconfig"
osource "/workdir/zephyr/soc/qemu/virt_riscv/Kconfig.defconfig"
osource "/workdir/zephyr/soc/qemu/malta/Kconfig.defconfig"
osource "/workdir/zephyr/soc/openisa/rv32m1/Kconfig.defconfig"
osource "/workdir/zephyr/soc/openhwgroup/cva6/Kconfig.defconfig"
osource "/workdir/zephyr/soc/oct/osd32mp15x/Kconfig.defconfig"
osource "/workdir/zephyr/soc/nxp/s32/Kconfig.defconfig"
osource "/workdir/zephyr/soc/nxp/rw/Kconfig.defconfig"
osource "/workdir/zephyr/soc/nxp/mcx/Kconfig.defconfig"
osource "/workdir/zephyr/soc/nxp/lpc/Kconfig.defconfig"
osource "/workdir/zephyr/soc/nxp/layerscape/Kconfig.defconfig"
osource "/workdir/zephyr/soc/nxp/kinetis/Kconfig.defconfig"
osource "/workdir/zephyr/soc/nxp/imxrt/Kconfig.defconfig"
osource "/workdir/zephyr/soc/nxp/imx/Kconfig.defconfig"
osource "/workdir/zephyr/soc/nuvoton/numicro/Kconfig.defconfig"
osource "/workdir/zephyr/soc/nuvoton/numaker/Kconfig.defconfig"
osource "/workdir/zephyr/soc/nuvoton/npcx/Kconfig.defconfig"
osource "/workdir/zephyr/soc/nuvoton/npcm/Kconfig.defconfig"
osource "/workdir/zephyr/soc/nordic/Kconfig.defconfig"
osource "/workdir/zephyr/soc/neorv32/Kconfig.defconfig"
osource "/workdir/zephyr/soc/native/inf_clock/Kconfig.defconfig"
osource "/workdir/zephyr/soc/microchip/sam/Kconfig.defconfig"
osource "/workdir/zephyr/soc/microchip/miv/Kconfig.defconfig"
osource "/workdir/zephyr/soc/microchip/mec/Kconfig.defconfig"
osource "/workdir/zephyr/soc/mediatek/mt8xxx/Kconfig.defconfig"
osource "/workdir/zephyr/soc/lowrisc/opentitan/Kconfig.defconfig"
osource "/workdir/zephyr/soc/litex/litex_vexriscv/Kconfig.defconfig"
osource "/workdir/zephyr/soc/ite/ec/Kconfig.defconfig"
osource "/workdir/zephyr/soc/intel/raptor_lake/Kconfig.defconfig"
osource "/workdir/zephyr/soc/intel/lakemont/Kconfig.defconfig"
osource "/workdir/zephyr/soc/intel/intel_socfpga_std/Kconfig.defconfig"
osource "/workdir/zephyr/soc/intel/intel_socfpga/Kconfig.defconfig"
osource "/workdir/zephyr/soc/intel/intel_niosv/Kconfig.defconfig"
osource "/workdir/zephyr/soc/intel/intel_ish/Kconfig.defconfig"
osource "/workdir/zephyr/soc/intel/intel_adsp/Kconfig.defconfig"
osource "/workdir/zephyr/soc/intel/elkhart_lake/Kconfig.defconfig"
osource "/workdir/zephyr/soc/intel/atom/Kconfig.defconfig"
osource "/workdir/zephyr/soc/intel/apollo_lake/Kconfig.defconfig"
osource "/workdir/zephyr/soc/intel/alder_lake/Kconfig.defconfig"
osource "/workdir/zephyr/soc/infineon/cat3/Kconfig.defconfig"
osource "/workdir/zephyr/soc/infineon/cat1c/Kconfig.defconfig"
osource "/workdir/zephyr/soc/infineon/cat1b/Kconfig.defconfig"
osource "/workdir/zephyr/soc/infineon/cat1a/Kconfig.defconfig"
osource "/workdir/zephyr/soc/gd/gd32/Kconfig.defconfig"
osource "/workdir/zephyr/soc/gaisler/leon3/Kconfig.defconfig"
osource "/workdir/zephyr/soc/gaisler/gr716a/Kconfig.defconfig"
osource "/workdir/zephyr/soc/espressif/Kconfig.defconfig"
osource "/workdir/zephyr/soc/ene/kb1200/Kconfig.defconfig"
osource "/workdir/zephyr/soc/efinix/sapphire/Kconfig.defconfig"
osource "/workdir/zephyr/soc/cdns/xtensa_sample_controller/Kconfig.defconfig"
osource "/workdir/zephyr/soc/cdns/sample_controller32/Kconfig.defconfig"
osource "/workdir/zephyr/soc/cdns/dc233c/Kconfig.defconfig"
osource "/workdir/zephyr/soc/brcm/bcmvk/Kconfig.defconfig"
osource "/workdir/zephyr/soc/brcm/bcm2712/Kconfig.defconfig"
osource "/workdir/zephyr/soc/brcm/bcm2711/Kconfig.defconfig"
osource "/workdir/zephyr/soc/bflb/Kconfig.defconfig"
osource "/workdir/zephyr/soc/atmel/sam0/Kconfig.defconfig"
osource "/workdir/zephyr/soc/atmel/sam/Kconfig.defconfig"
osource "/workdir/zephyr/soc/aspeed/Kconfig.defconfig"
osource "/workdir/zephyr/soc/arm/Kconfig.defconfig"
osource "/workdir/zephyr/soc/arm/beetle/Kconfig.defconfig"
osource "/workdir/zephyr/soc/antmicro/myra/Kconfig.defconfig"
osource "/workdir/zephyr/soc/andestech/Kconfig.defconfig"
osource "/workdir/zephyr/soc/amd/acp_6_0/Kconfig.defconfig"
osource "/workdir/zephyr/soc/ambiq/Kconfig.defconfig"
osource "/workdir/zephyr/soc/aesc/Kconfig.defconfig"
osource "/workdir/zephyr/soc/adi/max32/Kconfig.defconfig"
osource "/workdir/nrf/soc/sercomm/nrf91/Kconfig.defconfig"
osource "/workdir/nrf/soc/nordic/Kconfig.defconfig"
```

## build/hello_oemga/Kconfig/soc/Kconfig.soc
```kconfig
# Load SoC Kconfig descriptions.
osource "/workdir/zephyr/soc/xlnx/zynqmp/Kconfig.soc"
osource "/workdir/zephyr/soc/xlnx/zynq7000/Kconfig.soc"
osource "/workdir/zephyr/soc/xlnx/versalnet/Kconfig.soc"
osource "/workdir/zephyr/soc/xlnx/versal2/Kconfig.soc"
osource "/workdir/zephyr/soc/xen/Kconfig.soc"
osource "/workdir/zephyr/soc/wch/ch32v/Kconfig.soc"
osource "/workdir/zephyr/soc/ti/simplelink/Kconfig.soc"
osource "/workdir/zephyr/soc/ti/mspm0/Kconfig.soc"
osource "/workdir/zephyr/soc/ti/lm3s6965/Kconfig.soc"
osource "/workdir/zephyr/soc/ti/k3/Kconfig.soc"
osource "/workdir/zephyr/soc/telink/tlsr/Kconfig.soc"
osource "/workdir/zephyr/soc/starfive/jh71xx/Kconfig.soc"
osource "/workdir/zephyr/soc/st/stm32/Kconfig.soc"
osource "/workdir/zephyr/soc/snps/qemu_arc/Kconfig.soc"
osource "/workdir/zephyr/soc/snps/nsim/arc_v/Kconfig.soc"
osource "/workdir/zephyr/soc/snps/nsim/arc_classic/Kconfig.soc"
osource "/workdir/zephyr/soc/snps/hsdk4xd/Kconfig.soc"
osource "/workdir/zephyr/soc/snps/hsdk/Kconfig.soc"
osource "/workdir/zephyr/soc/snps/emsk/Kconfig.soc"
osource "/workdir/zephyr/soc/snps/emsdp/Kconfig.soc"
osource "/workdir/zephyr/soc/snps/arc_iot/Kconfig.soc"
osource "/workdir/zephyr/soc/silabs/Kconfig.soc"
osource "/workdir/zephyr/soc/sifive/sifive_freedom/Kconfig.soc"
osource "/workdir/zephyr/soc/sensry/Kconfig.soc"
osource "/workdir/zephyr/soc/rockchip/Kconfig.soc"
osource "/workdir/zephyr/soc/renode/riscv_virtual/Kconfig.soc"
osource "/workdir/zephyr/soc/renode/cortex_r8_virtual/Kconfig.soc"
osource "/workdir/zephyr/soc/renesas/smartbond/Kconfig.soc"
osource "/workdir/zephyr/soc/renesas/rz/Kconfig.soc"
osource "/workdir/zephyr/soc/renesas/rx/Kconfig.soc"
osource "/workdir/zephyr/soc/renesas/rcar/Kconfig.soc"
osource "/workdir/zephyr/soc/renesas/ra/Kconfig.soc"
osource "/workdir/zephyr/soc/realtek/ec/Kconfig.soc"
osource "/workdir/zephyr/soc/raspberrypi/rpi_pico/Kconfig.soc"
osource "/workdir/zephyr/soc/quicklogic/eos_s3/Kconfig.soc"
osource "/workdir/zephyr/soc/qemu/virt_riscv/Kconfig.soc"
osource "/workdir/zephyr/soc/qemu/malta/Kconfig.soc"
osource "/workdir/zephyr/soc/openisa/rv32m1/Kconfig.soc"
osource "/workdir/zephyr/soc/openhwgroup/cva6/Kconfig.soc"
osource "/workdir/zephyr/soc/oct/osd32mp15x/Kconfig.soc"
osource "/workdir/zephyr/soc/nxp/s32/Kconfig.soc"
osource "/workdir/zephyr/soc/nxp/rw/Kconfig.soc"
osource "/workdir/zephyr/soc/nxp/mcx/Kconfig.soc"
osource "/workdir/zephyr/soc/nxp/lpc/Kconfig.soc"
osource "/workdir/zephyr/soc/nxp/layerscape/Kconfig.soc"
osource "/workdir/zephyr/soc/nxp/kinetis/Kconfig.soc"
osource "/workdir/zephyr/soc/nxp/imxrt/Kconfig.soc"
osource "/workdir/zephyr/soc/nxp/imx/Kconfig.soc"
osource "/workdir/zephyr/soc/nuvoton/numicro/Kconfig.soc"
osource "/workdir/zephyr/soc/nuvoton/numaker/Kconfig.soc"
osource "/workdir/zephyr/soc/nuvoton/npcx/Kconfig.soc"
osource "/workdir/zephyr/soc/nuvoton/npcm/Kconfig.soc"
osource "/workdir/zephyr/soc/nordic/Kconfig.soc"
osource "/workdir/zephyr/soc/neorv32/Kconfig.soc"
osource "/workdir/zephyr/soc/native/inf_clock/Kconfig.soc"
osource "/workdir/zephyr/soc/microchip/sam/Kconfig.soc"
osource "/workdir/zephyr/soc/microchip/miv/Kconfig.soc"
osource "/workdir/zephyr/soc/microchip/mec/Kconfig.soc"
osource "/workdir/zephyr/soc/mediatek/mt8xxx/Kconfig.soc"
osource "/workdir/zephyr/soc/lowrisc/opentitan/Kconfig.soc"
osource "/workdir/zephyr/soc/litex/litex_vexriscv/Kconfig.soc"
osource "/workdir/zephyr/soc/ite/ec/Kconfig.soc"
osource "/workdir/zephyr/soc/intel/raptor_lake/Kconfig.soc"
osource "/workdir/zephyr/soc/intel/lakemont/Kconfig.soc"
osource "/workdir/zephyr/soc/intel/intel_socfpga_std/Kconfig.soc"
osource "/workdir/zephyr/soc/intel/intel_socfpga/Kconfig.soc"
osource "/workdir/zephyr/soc/intel/intel_niosv/Kconfig.soc"
osource "/workdir/zephyr/soc/intel/intel_ish/Kconfig.soc"
osource "/workdir/zephyr/soc/intel/intel_adsp/Kconfig.soc"
osource "/workdir/zephyr/soc/intel/elkhart_lake/Kconfig.soc"
osource "/workdir/zephyr/soc/intel/atom/Kconfig.soc"
osource "/workdir/zephyr/soc/intel/apollo_lake/Kconfig.soc"
osource "/workdir/zephyr/soc/intel/alder_lake/Kconfig.soc"
osource "/workdir/zephyr/soc/infineon/cat3/Kconfig.soc"
osource "/workdir/zephyr/soc/infineon/cat1c/Kconfig.soc"
osource "/workdir/zephyr/soc/infineon/cat1b/Kconfig.soc"
osource "/workdir/zephyr/soc/infineon/cat1a/Kconfig.soc"
osource "/workdir/zephyr/soc/gd/gd32/Kconfig.soc"
osource "/workdir/zephyr/soc/gaisler/leon3/Kconfig.soc"
osource "/workdir/zephyr/soc/gaisler/gr716a/Kconfig.soc"
osource "/workdir/zephyr/soc/espressif/Kconfig.soc"
osource "/workdir/zephyr/soc/ene/kb1200/Kconfig.soc"
osource "/workdir/zephyr/soc/efinix/sapphire/Kconfig.soc"
osource "/workdir/zephyr/soc/cdns/xtensa_sample_controller/Kconfig.soc"
osource "/workdir/zephyr/soc/cdns/sample_controller32/Kconfig.soc"
osource "/workdir/zephyr/soc/cdns/dc233c/Kconfig.soc"
osource "/workdir/zephyr/soc/brcm/bcmvk/Kconfig.soc"
osource "/workdir/zephyr/soc/brcm/bcm2712/Kconfig.soc"
osource "/workdir/zephyr/soc/brcm/bcm2711/Kconfig.soc"
osource "/workdir/zephyr/soc/bflb/Kconfig.soc"
osource "/workdir/zephyr/soc/atmel/sam0/Kconfig.soc"
osource "/workdir/zephyr/soc/atmel/sam/Kconfig.soc"
osource "/workdir/zephyr/soc/aspeed/Kconfig.soc"
osource "/workdir/zephyr/soc/arm/Kconfig.soc"
osource "/workdir/zephyr/soc/arm/beetle/Kconfig.soc"
osource "/workdir/zephyr/soc/antmicro/myra/Kconfig.soc"
osource "/workdir/zephyr/soc/andestech/Kconfig.soc"
osource "/workdir/zephyr/soc/amd/acp_6_0/Kconfig.soc"
osource "/workdir/zephyr/soc/ambiq/Kconfig.soc"
osource "/workdir/zephyr/soc/aesc/Kconfig.soc"
osource "/workdir/zephyr/soc/adi/max32/Kconfig.soc"
osource "/workdir/nrf/soc/sercomm/nrf91/Kconfig.soc"
osource "/workdir/nrf/soc/nordic/Kconfig.soc"
```
