## apps/imu_data_log/boards/bl54l15u_dvk_nrf54l15_cpuapp.conf
```kconfig
# OEMGA ALPHA BOARD CONFIGURATION
# Overrides for Kconfig defaults go here

# Example: Increase main stack size for OEMGA specific logic
CONFIG_MAIN_STACK_SIZE=2048

# Example: If OEMGA uses a different console backend
# CONFIG_CONSOLE=y
```

## build/Kconfig/Kconfig.modules
```kconfig
menu "nrf (/workdir/nrf)"
osource "/workdir/nrf/Kconfig.nrf"
config ZEPHYR_NRF_MODULE
	bool
	default y
endmenu
menu "hostap (/workdir/modules/lib/hostap)"
osource "$(ZEPHYR_HOSTAP_KCONFIG)"
config ZEPHYR_HOSTAP_MODULE
	bool
	default y
endmenu
menu "mcuboot (/workdir/bootloader/mcuboot)"
osource "$(ZEPHYR_MCUBOOT_KCONFIG)"
config ZEPHYR_MCUBOOT_MODULE
	bool
	default y
endmenu
menu "mbedtls (/workdir/modules/crypto/mbedtls)"
osource "$(ZEPHYR_MBEDTLS_KCONFIG)"
config ZEPHYR_MBEDTLS_MODULE
	bool
	default y
endmenu
menu "oberon-psa-crypto (/workdir/modules/crypto/oberon-psa-crypto)"
osource "/workdir/modules/crypto/oberon-psa-crypto/Kconfig.oberon_psa_crypto"
config ZEPHYR_OBERON_PSA_CRYPTO_MODULE
	bool
	default y
endmenu
menu "trusted-firmware-m (/workdir/modules/tee/tf-m/trusted-firmware-m)"
osource "$(ZEPHYR_TRUSTED_FIRMWARE_M_KCONFIG)"
config ZEPHYR_TRUSTED_FIRMWARE_M_MODULE
	bool
	default y
endmenu
config ZEPHYR_PSA_ARCH_TESTS_MODULE
	bool
	default y
menu "cjson (/workdir/modules/lib/cjson)"
osource "$(ZEPHYR_CJSON_KCONFIG)"
config ZEPHYR_CJSON_MODULE
	bool
	default y
endmenu
menu "azure-sdk-for-c (/workdir/modules/lib/azure-sdk-for-c)"
osource "$(ZEPHYR_AZURE_SDK_FOR_C_KCONFIG)"
config ZEPHYR_AZURE_SDK_FOR_C_MODULE
	bool
	default y
endmenu
menu "cirrus-logic (/workdir/modules/hal/cirrus-logic)"
osource "/workdir/modules/hal/cirrus-logic/Kconfig"
config ZEPHYR_CIRRUS_LOGIC_MODULE
	bool
	default y
endmenu
menu "openthread (/workdir/modules/lib/openthread)"
osource "$(ZEPHYR_OPENTHREAD_KCONFIG)"
config ZEPHYR_OPENTHREAD_MODULE
	bool
	default y
endmenu
menu "memfault-firmware-sdk (/workdir/modules/lib/memfault-firmware-sdk)"
osource "/workdir/modules/lib/memfault-firmware-sdk/ports/zephyr/Kconfig"
config ZEPHYR_MEMFAULT_FIRMWARE_SDK_MODULE
	bool
	default y
endmenu
menu "coremark (/workdir/modules/benchmark/coremark)"
osource "$(ZEPHYR_COREMARK_KCONFIG)"
config ZEPHYR_COREMARK_MODULE
	bool
	default y
endmenu
menu "canopennode (/workdir/modules/lib/canopennode)"
osource "$(ZEPHYR_CANOPENNODE_KCONFIG)"
config ZEPHYR_CANOPENNODE_MODULE
	bool
	default y
endmenu
menu "chre (/workdir/modules/lib/chre)"
osource "/workdir/modules/lib/chre/platform/zephyr/Kconfig"
config ZEPHYR_CHRE_MODULE
	bool
	default y
endmenu
menu "lz4 (/workdir/modules/lib/lz4)"
osource "$(ZEPHYR_LZ4_KCONFIG)"
config ZEPHYR_LZ4_MODULE
	bool
	default y
endmenu
menu "nanopb (/workdir/modules/lib/nanopb)"
osource "$(ZEPHYR_NANOPB_KCONFIG)"
config ZEPHYR_NANOPB_MODULE
	bool
	default y
endmenu
config ZEPHYR_TF_M_TESTS_MODULE
	bool
	default y
menu "zscilib (/workdir/modules/lib/zscilib)"
osource "/workdir/modules/lib/zscilib/Kconfig.zscilib"
config ZEPHYR_ZSCILIB_MODULE
	bool
	default y
endmenu
menu "cmsis (/workdir/modules/hal/cmsis)"
osource "$(ZEPHYR_CMSIS_KCONFIG)"
config ZEPHYR_CMSIS_MODULE
	bool
	default y
endmenu
menu "cmsis-dsp (/workdir/modules/lib/cmsis-dsp)"
osource "$(ZEPHYR_CMSIS_DSP_KCONFIG)"
config ZEPHYR_CMSIS_DSP_MODULE
	bool
	default y
endmenu
menu "cmsis-nn (/workdir/modules/lib/cmsis-nn)"
osource "$(ZEPHYR_CMSIS_NN_KCONFIG)"
config ZEPHYR_CMSIS_NN_MODULE
	bool
	default y
endmenu
menu "cmsis_6 (/workdir/modules/hal/cmsis_6)"
osource "$(ZEPHYR_CMSIS_6_KCONFIG)"
config ZEPHYR_CMSIS_6_MODULE
	bool
	default y
endmenu
menu "fatfs (/workdir/modules/fs/fatfs)"
osource "$(ZEPHYR_FATFS_KCONFIG)"
config ZEPHYR_FATFS_MODULE
	bool
	default y
endmenu
menu "hal_nordic (/workdir/modules/hal/nordic)"
osource "$(ZEPHYR_HAL_NORDIC_KCONFIG)"
config ZEPHYR_HAL_NORDIC_MODULE
	bool
	default y

config ZEPHYR_HAL_NORDIC_MODULE_BLOBS
	bool
endmenu
menu "hal_st (/workdir/modules/hal/st)"
osource "$(ZEPHYR_HAL_ST_KCONFIG)"
config ZEPHYR_HAL_ST_MODULE
	bool
	default y
endmenu
menu "hal_tdk (/workdir/modules/hal/tdk)"
osource "$(ZEPHYR_HAL_TDK_KCONFIG)"
config ZEPHYR_HAL_TDK_MODULE
	bool
	default y
endmenu
config ZEPHYR_HAL_WURTHELEKTRONIK_MODULE
	bool
	default y
menu "liblc3 (/workdir/modules/lib/liblc3)"
osource "$(ZEPHYR_LIBLC3_KCONFIG)"
config ZEPHYR_LIBLC3_MODULE
	bool
	default y
endmenu
config ZEPHYR_LIBMETAL_MODULE
	bool
	default y
menu "littlefs (/workdir/modules/fs/littlefs)"
osource "$(ZEPHYR_LITTLEFS_KCONFIG)"
config ZEPHYR_LITTLEFS_MODULE
	bool
	default y
endmenu
menu "loramac-node (/workdir/modules/lib/loramac-node)"
osource "$(ZEPHYR_LORAMAC_NODE_KCONFIG)"
config ZEPHYR_LORAMAC_NODE_MODULE
	bool
	default y
endmenu
menu "lvgl (/workdir/modules/lib/gui/lvgl)"
osource "/workdir/modules/lib/gui/lvgl/zephyr/Kconfig"
config ZEPHYR_LVGL_MODULE
	bool
	default y
endmenu
config ZEPHYR_MIPI_SYS_T_MODULE
	bool
	default y
menu "nrf_wifi (/workdir/modules/lib/nrf_wifi)"
osource "$(ZEPHYR_NRF_WIFI_KCONFIG)"
config ZEPHYR_NRF_WIFI_MODULE
	bool
	default y

config ZEPHYR_NRF_WIFI_MODULE_BLOBS
	bool
endmenu
config ZEPHYR_OPEN_AMP_MODULE
	bool
	default y
menu "percepio (/workdir/modules/debug/percepio)"
osource "/workdir/modules/debug/percepio/zephyr/Kconfig"
config ZEPHYR_PERCEPIO_MODULE
	bool
	default y
endmenu
menu "picolibc (/workdir/modules/lib/picolibc)"
osource "/workdir/modules/lib/picolibc/zephyr/Kconfig"
config ZEPHYR_PICOLIBC_MODULE
	bool
	default y
endmenu
menu "segger (/workdir/modules/debug/segger)"
osource "$(ZEPHYR_SEGGER_KCONFIG)"
config ZEPHYR_SEGGER_MODULE
	bool
	default y
endmenu
config ZEPHYR_TINYCRYPT_MODULE
	bool
	default y
menu "uoscore-uedhoc (/workdir/modules/lib/uoscore-uedhoc)"
osource "$(ZEPHYR_UOSCORE_UEDHOC_KCONFIG)"
config ZEPHYR_UOSCORE_UEDHOC_MODULE
	bool
	default y
endmenu
menu "zcbor (/workdir/modules/lib/zcbor)"
osource "$(ZEPHYR_ZCBOR_KCONFIG)"
config ZEPHYR_ZCBOR_MODULE
	bool
	default y
endmenu
menu "nrfxlib (/workdir/nrfxlib)"
osource "/workdir/nrfxlib/Kconfig.nrfxlib"
config ZEPHYR_NRFXLIB_MODULE
	bool
	default y
endmenu
config ZEPHYR_NRF_HW_MODELS_MODULE
	bool
	default y
menu "connectedhomeip (/workdir/modules/lib/matter)"
osource "/workdir/modules/lib/matter/config/nrfconnect/chip-module/Kconfig"
config ZEPHYR_CONNECTEDHOMEIP_MODULE
	bool
	default y
endmenu
```

## build/Kconfig/arch/Kconfig
```kconfig
# Load Zephyr Arch Kconfig descriptions.
osource "/workdir/zephyr/arch/rx/Kconfig"
osource "/workdir/zephyr/arch/x86/Kconfig"
osource "/workdir/zephyr/arch/xtensa/Kconfig"
osource "/workdir/zephyr/arch/sparc/Kconfig"
osource "/workdir/zephyr/arch/riscv/Kconfig"
osource "/workdir/zephyr/arch/posix/Kconfig"
osource "/workdir/zephyr/arch/mips/Kconfig"
osource "/workdir/zephyr/arch/arm64/Kconfig"
osource "/workdir/zephyr/arch/arm/Kconfig"
osource "/workdir/zephyr/arch/arc/Kconfig"
```

## build/Kconfig/boards/Kconfig
```kconfig
# Load Zephyr board Kconfig descriptions.
osource "/workdir/zephyr/boards/ezurio/bl54l15u_dvk/Kconfig"
```

## build/Kconfig/boards/Kconfig.defconfig
```kconfig
# Load Zephyr board defconfig descriptions.
osource "/workdir/zephyr/boards/ezurio/bl54l15u_dvk/Kconfig.defconfig"
```

## build/Kconfig/boards/Kconfig.sysbuild
```kconfig
# Load Sysbuild board Kconfig descriptions.
osource "/workdir/zephyr/boards/ezurio/bl54l15u_dvk/Kconfig.sysbuild"
```

## build/Kconfig/soc/Kconfig
```kconfig
# Load Zephyr SoC Kconfig descriptions.
osource "/workdir/zephyr/soc/xlnx/zynqmp/Kconfig"
osource "/workdir/zephyr/soc/xlnx/zynq7000/Kconfig"
osource "/workdir/zephyr/soc/xlnx/versalnet/Kconfig"
osource "/workdir/zephyr/soc/xlnx/versal2/Kconfig"
osource "/workdir/zephyr/soc/xen/Kconfig"
osource "/workdir/zephyr/soc/wch/ch32v/Kconfig"
osource "/workdir/zephyr/soc/ti/simplelink/Kconfig"
osource "/workdir/zephyr/soc/ti/mspm0/Kconfig"
osource "/workdir/zephyr/soc/ti/lm3s6965/Kconfig"
osource "/workdir/zephyr/soc/ti/k3/Kconfig"
osource "/workdir/zephyr/soc/telink/tlsr/Kconfig"
osource "/workdir/zephyr/soc/starfive/jh71xx/Kconfig"
osource "/workdir/zephyr/soc/st/stm32/Kconfig"
osource "/workdir/zephyr/soc/snps/qemu_arc/Kconfig"
osource "/workdir/zephyr/soc/snps/nsim/arc_v/Kconfig"
osource "/workdir/zephyr/soc/snps/nsim/arc_classic/Kconfig"
osource "/workdir/zephyr/soc/snps/hsdk4xd/Kconfig"
osource "/workdir/zephyr/soc/snps/hsdk/Kconfig"
osource "/workdir/zephyr/soc/snps/emsk/Kconfig"
osource "/workdir/zephyr/soc/snps/emsdp/Kconfig"
osource "/workdir/zephyr/soc/snps/arc_iot/Kconfig"
osource "/workdir/zephyr/soc/silabs/Kconfig"
osource "/workdir/zephyr/soc/sifive/sifive_freedom/Kconfig"
osource "/workdir/zephyr/soc/sensry/Kconfig"
osource "/workdir/zephyr/soc/rockchip/Kconfig"
osource "/workdir/zephyr/soc/renode/riscv_virtual/Kconfig"
osource "/workdir/zephyr/soc/renode/cortex_r8_virtual/Kconfig"
osource "/workdir/zephyr/soc/renesas/smartbond/Kconfig"
osource "/workdir/zephyr/soc/renesas/rz/Kconfig"
osource "/workdir/zephyr/soc/renesas/rx/Kconfig"
osource "/workdir/zephyr/soc/renesas/rcar/Kconfig"
osource "/workdir/zephyr/soc/renesas/ra/Kconfig"
osource "/workdir/zephyr/soc/realtek/ec/Kconfig"
osource "/workdir/zephyr/soc/raspberrypi/rpi_pico/Kconfig"
osource "/workdir/zephyr/soc/quicklogic/eos_s3/Kconfig"
osource "/workdir/zephyr/soc/qemu/virt_riscv/Kconfig"
osource "/workdir/zephyr/soc/qemu/malta/Kconfig"
osource "/workdir/zephyr/soc/openisa/rv32m1/Kconfig"
osource "/workdir/zephyr/soc/openhwgroup/cva6/Kconfig"
osource "/workdir/zephyr/soc/oct/osd32mp15x/Kconfig"
osource "/workdir/zephyr/soc/nxp/s32/Kconfig"
osource "/workdir/zephyr/soc/nxp/rw/Kconfig"
osource "/workdir/zephyr/soc/nxp/mcx/Kconfig"
osource "/workdir/zephyr/soc/nxp/lpc/Kconfig"
osource "/workdir/zephyr/soc/nxp/layerscape/Kconfig"
osource "/workdir/zephyr/soc/nxp/kinetis/Kconfig"
osource "/workdir/zephyr/soc/nxp/imxrt/Kconfig"
osource "/workdir/zephyr/soc/nxp/imx/Kconfig"
osource "/workdir/zephyr/soc/nuvoton/numicro/Kconfig"
osource "/workdir/zephyr/soc/nuvoton/numaker/Kconfig"
osource "/workdir/zephyr/soc/nuvoton/npcx/Kconfig"
osource "/workdir/zephyr/soc/nuvoton/npcm/Kconfig"
osource "/workdir/zephyr/soc/nordic/Kconfig"
osource "/workdir/zephyr/soc/neorv32/Kconfig"
osource "/workdir/zephyr/soc/native/inf_clock/Kconfig"
osource "/workdir/zephyr/soc/microchip/sam/Kconfig"
osource "/workdir/zephyr/soc/microchip/miv/Kconfig"
osource "/workdir/zephyr/soc/microchip/mec/Kconfig"
osource "/workdir/zephyr/soc/mediatek/mt8xxx/Kconfig"
osource "/workdir/zephyr/soc/lowrisc/opentitan/Kconfig"
osource "/workdir/zephyr/soc/litex/litex_vexriscv/Kconfig"
osource "/workdir/zephyr/soc/ite/ec/Kconfig"
osource "/workdir/zephyr/soc/intel/raptor_lake/Kconfig"
osource "/workdir/zephyr/soc/intel/lakemont/Kconfig"
osource "/workdir/zephyr/soc/intel/intel_socfpga_std/Kconfig"
osource "/workdir/zephyr/soc/intel/intel_socfpga/Kconfig"
osource "/workdir/zephyr/soc/intel/intel_niosv/Kconfig"
osource "/workdir/zephyr/soc/intel/intel_ish/Kconfig"
osource "/workdir/zephyr/soc/intel/intel_adsp/Kconfig"
osource "/workdir/zephyr/soc/intel/elkhart_lake/Kconfig"
osource "/workdir/zephyr/soc/intel/atom/Kconfig"
osource "/workdir/zephyr/soc/intel/apollo_lake/Kconfig"
osource "/workdir/zephyr/soc/intel/alder_lake/Kconfig"
osource "/workdir/zephyr/soc/infineon/cat3/Kconfig"
osource "/workdir/zephyr/soc/infineon/cat1c/Kconfig"
osource "/workdir/zephyr/soc/infineon/cat1b/Kconfig"
osource "/workdir/zephyr/soc/infineon/cat1a/Kconfig"
osource "/workdir/zephyr/soc/gd/gd32/Kconfig"
osource "/workdir/zephyr/soc/gaisler/leon3/Kconfig"
osource "/workdir/zephyr/soc/gaisler/gr716a/Kconfig"
osource "/workdir/zephyr/soc/espressif/Kconfig"
osource "/workdir/zephyr/soc/ene/kb1200/Kconfig"
osource "/workdir/zephyr/soc/efinix/sapphire/Kconfig"
osource "/workdir/zephyr/soc/cdns/xtensa_sample_controller/Kconfig"
osource "/workdir/zephyr/soc/cdns/sample_controller32/Kconfig"
osource "/workdir/zephyr/soc/cdns/dc233c/Kconfig"
osource "/workdir/zephyr/soc/brcm/bcmvk/Kconfig"
osource "/workdir/zephyr/soc/brcm/bcm2712/Kconfig"
osource "/workdir/zephyr/soc/brcm/bcm2711/Kconfig"
osource "/workdir/zephyr/soc/bflb/Kconfig"
osource "/workdir/zephyr/soc/atmel/sam0/Kconfig"
osource "/workdir/zephyr/soc/atmel/sam/Kconfig"
osource "/workdir/zephyr/soc/aspeed/Kconfig"
osource "/workdir/zephyr/soc/arm/Kconfig"
osource "/workdir/zephyr/soc/arm/beetle/Kconfig"
osource "/workdir/zephyr/soc/antmicro/myra/Kconfig"
osource "/workdir/zephyr/soc/andestech/Kconfig"
osource "/workdir/zephyr/soc/amd/acp_6_0/Kconfig"
osource "/workdir/zephyr/soc/ambiq/Kconfig"
osource "/workdir/zephyr/soc/aesc/Kconfig"
osource "/workdir/zephyr/soc/adi/max32/Kconfig"
osource "/workdir/nrf/soc/sercomm/nrf91/Kconfig"
osource "/workdir/nrf/soc/nordic/Kconfig"
```

## build/hello_oemga/Kconfig/boards/Kconfig.bl54l15u_dvk
```kconfig
# Load board Kconfig descriptions.
osource "/workdir/zephyr/boards/ezurio/bl54l15u_dvk/Kconfig.bl54l15u_dvk"
```
