## CMakeLists.txt
```
cmake_minimum_required(VERSION 3.20.0)
find_package(Zephyr REQUIRED HINTS $ENV{ZEPHYR_BASE})
project(hello_oemga)

target_sources(app PRIVATE src/main.c)
```

## prj.conf
```kconfig
CONFIG_LOG=y
CONFIG_GPIO=y
```

## boards/bl54l15u_dvk_nrf54l15_cpuapp.overlay
```dts
/*
 * OEMGA ALPHA BOARD OVERLAY
 * Target: bl54l15u_dvk_nrf54l15_cpuapp
 * * This file applies hardware changes specific to the OEMGA prototype
 * on top of the standard bl54l15u_dvk definition.
 */

/ {
    model = "OEMGA Alpha Prototype";
    
    /* Example: Override a chosen node or alias if OEMGA pins differ */
    /* aliases {
        led0 = &my_custom_led;
    };
    */
};

/* Example: Disabling a DVK feature not present on OEMGA */
/* &button0 { status = "disabled"; }; */
```

## src/main.c
```c
#include <zephyr/kernel.h>
#include <zephyr/drivers/gpio.h>
#include <zephyr/logging/log.h>

LOG_MODULE_REGISTER(hello_oemga, LOG_LEVEL_INF);

/* * This sample assumes the standard 'led0' alias is defined in the 
 * Device Tree. On the upstream DVK, this is usually LED 1.
 * We will verify this works even with our Overlay.
 */
static const struct gpio_dt_spec led = GPIO_DT_SPEC_GET(DT_ALIAS(led0), gpios);

int main(void)
{
    int ret;

    LOG_INF("booting oemga_alpha...");
    LOG_INF("Board target: %s", CONFIG_BOARD);

    if (!gpio_is_ready_dt(&led)) {
        LOG_ERR("LED device not ready");
        return 0;
    }

    ret = gpio_pin_configure_dt(&led, GPIO_OUTPUT_ACTIVE);
    if (ret < 0) {
        return 0;
    }

    while (1) {
        ret = gpio_pin_toggle_dt(&led);
        LOG_INF("Hello OEMGA! LED State: %d", ret);
        k_msleep(1000);
    }
    return 0;
}
```
